## AutoDine_Host/sdkconfig.defaults
```kconfig
CONFIG_ESPTOOLPY_FLASHSIZE_4MB=y
CONFIG_PARTITION_TABLE_SINGLE_APP_LARGE=y
CONFIG_COMPILER_OPTIMIZATION_SIZE=y
CONFIG_FREERTOS_HZ=1000
CONFIG_ESP_TASK_WDT_TIMEOUT_S=10
CONFIG_HTTPD_MAX_REQ_HDR_LEN=1024
CONFIG_HTTPD_MAX_URI_LEN=512
```

## AutoDine_Table/sdkconfig.defaults
```kconfig
# Partition Table
CONFIG_ESPTOOLPY_FLASHSIZE_4MB=y
CONFIG_PARTITION_TABLE_SINGLE_APP=y

# Compiler Optimization
CONFIG_COMPILER_OPTIMIZATION_SIZE=y

# FreeRTOS
CONFIG_FREERTOS_HZ=1000

# WiFi Stability Settings
CONFIG_ESP32_WIFI_STATIC_RX_BUFFER_NUM=10
CONFIG_ESP32_WIFI_DYNAMIC_RX_BUFFER_NUM=32
CONFIG_ESP32_WIFI_DYNAMIC_TX_BUFFER_NUM=32
CONFIG_ESP32_WIFI_AMPDU_TX_ENABLED=y
CONFIG_ESP32_WIFI_AMPDU_RX_ENABLED=y
CONFIG_ESP32_WIFI_NVS_ENABLED=y

# Power Management - DISABLED for WiFi stability
CONFIG_PM_ENABLE=n

# Task Watchdog
CONFIG_ESP_TASK_WDT_TIMEOUT_S=10
CONFIG_ESP_TASK_WDT_CHECK_IDLE_TASK_CPU0=n
CONFIG_ESP_TASK_WDT_CHECK_IDLE_TASK_CPU1=n

# HTTP Client
CONFIG_ESP_HTTP_CLIENT_ENABLE_HTTPS=n
```

## Restaurant_Menu/main/Kconfig.projbuild
```kconfig
menu "Restaurant Menu Configuration"

    config BUTTON_SCROLL_GPIO
        int "Scroll Button GPIO"
        default 18
        help
            GPIO pin for scroll button

    config BUTTON_SELECT_GPIO
        int "Select Button GPIO"
        default 19
        help
            GPIO pin for select button

endmenu
```
